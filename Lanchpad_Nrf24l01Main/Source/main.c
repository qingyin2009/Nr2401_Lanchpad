/*************************************************************************************************
                                    主程序
*************************************************************************************************/
    #include "..\Include\Vars.h"
    #include "..\Include\Init.h"
    #include "..\Include\Timer.h"
    #include "..\Include\Wireless.h"

uint8 Data;
/*******************************************************************************\
名称：Sys_Init(void)
作用：时钟初始化处理
参数：无
描述：无
\*******************************************************************************/
void Sys_Init(void)
{
  BCSCTL1 = CALBC1_8MHZ;
  DCOCTL = CALDCO_8MHZ;
}

/*******************************************************************************\
名称：Delay(void)
作用：延时
参数：无
描述：无
\*******************************************************************************/
void Delay(void)
{
  uint16 i,j; 
  for (i=0; i< 255; i++)
   {
      for (j=0; j<255; j++);
   }
}

/*******************************************************************************\
名称：main(void)
作用：主函数
参数：无
描述：无
\*******************************************************************************/
void main(void)
{
  // Stop watchdog timer to prevent time out reset
  WDTCTL = WDTPW + WDTHOLD;
  
  Port_Init();      //先初始化端口
  
  Sys_Init();       //时钟初始化
  
  Init_Process();   //初始化处理
  
  _BIS_SR(GIE);     //打开中断
  
  while(1)
  {
    Data = 1;
    if (gbTimer1msRead)
    {
      gbTimer1msSet0;
      SPI_Write_Data(2, &Data, 1);
      SPI_Read_Data(2, &Data, 1);
    }
  }
}

 /*******************************************************************************\
名称：main(void)
作用：主函数
参数：无
描述：无
\*******************************************************************************/
#pragma vector = TIMER0_A1_VECTOR
__interrupt void TIMER0_A1_ISR(void)
{
   IntTimerBase();        //时基中断处理
   TA0CTL &= ~TAIFG;      //清中断标志
}

/*************************************************************************************************
                                    结束主程序
*************************************************************************************************/